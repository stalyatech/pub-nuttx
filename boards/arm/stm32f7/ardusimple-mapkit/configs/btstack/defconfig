## boards/arm/stm32f7/ardusimple-sbc/Kconfig
```kconfig
#
# For a description of the syntax of this configuration file,
# see the file kconfig-language.txt in the NuttX tools repository.
#

if ARCH_BOARD_ARDUSIMPLE_SBC

choice
	prompt "Select SPI Flash File System"
	default ARDUSIMPLE_SBC_SPIFLASH_LITTLEFS

config ARDUSIMPLE_SBC_SPIFLASH_SMARTFS
	bool "Smart FS"

config ARDUSIMPLE_SBC_SPIFLASH_LITTLEFS
	bool "Little FS"

config ARDUSIMPLE_SBC_SPIFLASH_SPIFFS
	bool "SPI FFS"

config ARDUSIMPLE_SBC_SPIFLASH_NXFFS
	bool "NuttX FS"

endchoice

config ARDUSIMPLE_SBC_SPIFLASH_NPARTITIONS
	int "Number of partitions"
	default 2
	---help---
		This setting provides the number of partitions.

config STM32_ROMFS
	bool "Automount baked-in ROMFS image"
	default n
	depends on FS_ROMFS
	---help---
		Select STM32_ROMFS_IMAGEFILE, STM32_ROMFS_DEV_MINOR, STM32_ROMFS_MOUNTPOINT

config STM32_ROMFS_DEV_MINOR
	int "Minor for the block device backing the data"
	depends on STM32_ROMFS
	default 64

config STM32_ROMFS_MOUNTPOINT
	string "Mountpoint of the custom romfs image"
	depends on STM32_ROMFS
	default "/rom"

config STM32_ROMFS_IMAGEFILE
	string "ROMFS image file to include into build"
	depends on STM32_ROMFS
	default "../../../rom.img"

endif # ARCH_BOARD_ARDUSIMPLE_SBC
```

## boards/arm/stm32h7/gmtcnt-glc23x/Kconfig
```kconfig
#
# For a description of the syntax of this configuration file,
# see the file kconfig-language.txt in the NuttX tools repository.
#

if ARCH_BOARD_GMTCNT_GLC23X

choice
	prompt "Select SPI Flash File System"
	default GMTCNT_GLC23X_SPIFLASH_LITTLEFS

config GMTCNT_GLC23X_SPIFLASH_NONE
	bool "None"

config GMTCNT_GLC23X_SPIFLASH_SMARTFS
	bool "Smart FS"

config GMTCNT_GLC23X_SPIFLASH_LITTLEFS
	bool "Little FS"

config GMTCNT_GLC23X_SPIFLASH_SPIFFS
	bool "SPI FFS"

config GMTCNT_GLC23X_SPIFLASH_NXFFS
	bool "NuttX FS"

endchoice

config GMTCNT_GLC23X_SPIFLASH_NPARTMAIN
	int "Number of main partitions"
	default 2
	---help---
		This setting provides the number of main partitions.

config GMTCNT_GLC23X_SPIFLASH_NPARTRESV
	int "Number of resv partitions"
	default 2
	---help---
		This setting provides the number of reserved partitions.

config GMTCNT_GLC23X_SPIFLASH_SIZERESV
	int "Size of resv partitions"
	default 2097152
	---help---
		This setting provides the number of reserved partitions.

config STM32_ROMFS
	bool "Automount baked-in ROMFS image"
	default n
	depends on FS_ROMFS
	---help---
		Select STM32_ROMFS_IMAGEFILE, STM32_ROMFS_DEV_MINOR, STM32_ROMFS_MOUNTPOINT

config STM32_ROMFS_DEV_MINOR
	int "Minor for the block device backing the data"
	depends on STM32_ROMFS
	default 64

config STM32_ROMFS_MOUNTPOINT
	string "Mountpoint of the custom romfs image"
	depends on STM32_ROMFS
	default "/rom"

config STM32_ROMFS_IMAGEFILE
	string "ROMFS image file to include into build"
	depends on STM32_ROMFS
	default "../../../rom.img"

endif # ARCH_BOARD_GMTCNT_GLC23X
```

## drivers/usbmisc/Kconfig
```kconfig
#
# For a description of the syntax of this configuration file,
# see misc/tools/kconfig-language.txt.
#

menuconfig USBMISC
	bool "USB Miscellaneous drivers"
	default n
	---help---
		USB Miscellaneous drivers.

if USBMISC

config FUSB301
	bool "On Semiconductor FUSB301 USB Type-C controller support"
	default n
	select I2C
	---help---
		Enable device driver for Fairchild/On Semiconductor USB Type-C controller

if FUSB301

config FUSB301_I2C_FREQUENCY
	int "FUSB301 I2C frequency"
	default 400000
	range 1 400000

config DEBUG_FUSB301
	bool "Enable debug support for the FUSB301"
	default n
	---help---
		Enables debug support for the FUSB301

config FUSB301_NPOLLWAITERS
	int "Number of waiters to poll"
	default 2
	---help---
		Maximum number of threads that can be waiting on poll()

endif

config FUSB302
	bool "On Semiconductor FUSB302 USB Type-C controller support"
	default n
	select I2C
	---help---
		Enable device driver for Fairchild/On Semiconductor USB Type-C controller

if FUSB302

config FUSB302_NPOLLWAITERS
	int "Number of waiters to poll"
	default 2
	---help---
		Maximum number of threads that can be waiting on poll()

config DEBUG_FUSB302_REG
	bool "Enable register dumps for debug"
	default n

endif

config FUSB303
	bool "On Semiconductor FUSB303 USB Type-C controller support"
	default n
	select I2C
	---help---
		Enable device driver for Fairchild/On Semiconductor USB Type-C controller

if FUSB303

config FUSB303_I2C_FREQUENCY
	int "FUSB303 I2C frequency"
	default 400000
	range 1 400000

config DEBUG_FUSB303
	bool "Enable debug support for the FUSB303"
	default n
	---help---
		Enables debug support for the FUSB303

config FUSB303_NPOLLWAITERS
	int "Number of waiters to poll"
	default 2
	---help---
		Maximum number of threads that can be waiting on poll()

endif

config USB251X
	bool "Microchip USB251X USB hub controller support"
	default n
	select I2C
	---help---
		Enable device driver for Microchip USB Hub controller

if USB251X
config USB251X_I2C_FREQUENCY
	int "USB251X I2C frequency"
	default 100000
	range 1 100000

config DEBUG_USB251X
	bool "Enable debug support for the USB251X"
	default n
	---help---
		Enables debug support for the USB251X

config USB251X_BLOCK_SIZE
	int "Configuration block size"
	default 32
  range 1 32
	---help---
		Configuration block size for driver
endif # USB251X

endif # USBMISC
```

## libs/libc/flash/Kconfig
```kconfig
#
# For a description of the syntax of this configuration file,
# see the file kconfig-language.txt in the NuttX tools repository.
#

config LIBFLASH
	bool "Flash Partition Library"
	default n
```

## libs/libc/nmea/Kconfig
```kconfig
#
# For a description of the syntax of this configuration file,
# see the file kconfig-language.txt in the NuttX tools repository.
#

menu "Custom NMEA Library Options"

config LIBNMEA
	bool "Custom NMEA Library"
	default n

endmenu
```
